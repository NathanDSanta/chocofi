## boards/shields/chocofi/Kconfig.defconfig
```kconfig
# If this is the firmware for the left half
if SHIELD_CHOCOFI_LEFT

  # Set name
  config ZMK_KEYBOARD_NAME
    default "Nathan-Kb"

  # Set role to central
  config ZMK_SPLIT_ROLE_CENTRAL
    default y  

endif

# If any of the parts (this runs for both halves of the keyboard)
if SHIELD_CHOCOFI_LEFT || SHIELD_CHOCOFI_RIGHT

  config ZMK_SPLIT
    default y
endif
```

## boards/shields/chocofi/Kconfig.shield
```kconfig
# Left Half
config SHIELD_CHOCOFI_LEFT
  def_bool $(shields_list_contains,chocofi_left)
# Right Half
config SHIELD_CHOCOFI_RIGHT
  def_bool $(shields_list_contains,chocofi_right)
```

## boards/shields/nathan-chocofi/Kconfig.defconfig
```kconfig
# If this is the firmware for the left half
if SHIELD_NATHAN_CHOCOFI_LEFT

  # Set name
  config ZMK_KEYBOARD_NAME
    default "Nathan-Kb"

  # Set role to central
  config ZMK_SPLIT_ROLE_CENTRAL
    default y  

endif

# If any of the parts (this runs for both halves of the keyboard)
if SHIELD_NATHAN_CHOCOFI_LEFT || SHIELD_NATHAN_CHOCOFI_RIGTH

  config ZMK_SPLIT
    default y
endif
```
